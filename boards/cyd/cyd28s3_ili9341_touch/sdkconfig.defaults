## boards/cyd/cyd28s3_ili9341_touch/sdkconfig.defaults
```kconfig
# Target: ESP32-S3R8 (8MB OPI PSRAM, 16MB Flash)
CONFIG_IDF_TARGET="esp32s3"

# Flash
CONFIG_ESPTOOLPY_FLASHSIZE_16MB=y

# PSRAM — 8MB OPI (octal SPI)
CONFIG_SPIRAM=y
CONFIG_SPIRAM_MODE_OCT=y
CONFIG_SPIRAM_TYPE_AUTO=y

# Console — board has no dedicated USB-UART IC; Type-C uses USB_SERIAL_JTAG
CONFIG_ESP_CONSOLE_USB_SERIAL_JTAG=y

# CPU
CONFIG_ESP_DEFAULT_CPU_FREQ_MHZ_240=y

# Main task stack
CONFIG_ESP_MAIN_TASK_STACK_SIZE=8192

# FreeRTOS tick rate
CONFIG_FREERTOS_HZ=1000
```

## boards/cyd/cyd35_st7796_touch/sdkconfig.defaults
```kconfig
# Target: ESP32-WROOM-32E (classic ESP32)
CONFIG_IDF_TARGET="esp32"

# Flash
CONFIG_ESPTOOLPY_FLASHSIZE_4MB=y

# Console — UART0
CONFIG_ESP_CONSOLE_UART_DEFAULT=y

# Main task stack
CONFIG_ESP_MAIN_TASK_STACK_SIZE=8192

# FreeRTOS tick rate
CONFIG_FREERTOS_HZ=1000
```

## boards/m5stack/tab5/sdkconfig.defaults
```kconfig
# Target: ESP32-P4
CONFIG_IDF_TARGET="esp32p4"

# Flash
CONFIG_ESPTOOLPY_FLASHSIZE_16MB=y

# CPU (360 MHz)
CONFIG_ESP_DEFAULT_CPU_FREQ_360=y
CONFIG_FREERTOS_HZ=1000

# Console — UART primary, USB JTAG secondary
CONFIG_ESP_CONSOLE_UART_DEFAULT=y
CONFIG_ESP_CONSOLE_SECONDARY_USB_SERIAL_JTAG=y
CONFIG_ESP_CONSOLE_ROM_SERIAL_PORT_NUM=0

# Main task stack
CONFIG_ESP_MAIN_TASK_STACK_SIZE=16384

# PSRAM (200 MHz, XIP enabled)
CONFIG_IDF_EXPERIMENTAL_FEATURES=y
CONFIG_SPIRAM=y
CONFIG_SPIRAM_SPEED_200M=y
CONFIG_SPIRAM_XIP_FROM_PSRAM=y
CONFIG_SPIRAM_USE_MALLOC=y
CONFIG_SPIRAM_MEMTEST=y
CONFIG_SPIRAM_MALLOC_ALWAYSINTERNAL=16384
CONFIG_SPIRAM_MALLOC_RESERVE_INTERNAL=32768
```

## boards/waveshare/wvshr185_round/features/tf_card/Kconfig
```kconfig
menu "TF Card (SD) Configuration"

    config TF_CARD_MOUNT_POINT
        string "VFS mount point"
        default "/sdcard"
        help
            Path where the SD card FAT filesystem will be mounted.

    config TF_CARD_MAX_FILES
        int "Maximum open files"
        default 4
        range 1 20
        help
            Maximum number of files that can be open simultaneously.

endmenu
```

## boards/waveshare/wvshr_p4_720_touch/sdkconfig.defaults
```kconfig
# Target: ESP32-P4
CONFIG_IDF_TARGET="esp32p4"

# Flash
CONFIG_ESPTOOLPY_FLASHSIZE_16MB=y

# CPU (360 MHz)
CONFIG_ESP_DEFAULT_CPU_FREQ_360=y
CONFIG_FREERTOS_HZ=1000

# Console — UART primary, USB JTAG secondary
# (EV board uses USB_SERIAL_JTAG primary — do not use that config here)
CONFIG_ESP_CONSOLE_UART_DEFAULT=y
CONFIG_ESP_CONSOLE_SECONDARY_USB_SERIAL_JTAG=y
CONFIG_ESP_CONSOLE_ROM_SERIAL_PORT_NUM=0

# Main task stack
CONFIG_ESP_MAIN_TASK_STACK_SIZE=16384

# PSRAM (HEX @ 200 MHz)
CONFIG_IDF_EXPERIMENTAL_FEATURES=y
CONFIG_SPIRAM=y
CONFIG_SPIRAM_MODE_HEX=y
CONFIG_SPIRAM_SPEED_200M=y
CONFIG_SPIRAM_USE_MALLOC=y
CONFIG_SPIRAM_MEMTEST=y
CONFIG_SPIRAM_MALLOC_ALWAYSINTERNAL=16384
CONFIG_SPIRAM_MALLOC_RESERVE_INTERNAL=32768

# esp_hosted: ESP32-C6 co-processor via SDIO for WiFi
CONFIG_ESP_HOSTED_ENABLED=y
CONFIG_ESP_HOSTED_SDIO_HOST_INTERFACE=y
CONFIG_ESP_HOSTED_IDF_SLAVE_TARGET="esp32c6"
CONFIG_ESP_HOSTED_SDIO_RESET_ACTIVE_HIGH=y
CONFIG_ESP_HOSTED_SDIO_GPIO_RESET_SLAVE=54
CONFIG_ESP_HOSTED_GPIO_SLAVE_RESET_SLAVE=54
CONFIG_ESP_HOSTED_SDIO_4_BIT_BUS=y
CONFIG_ESP_HOSTED_SDIO_BUS_WIDTH=4
CONFIG_ESP_HOSTED_SDIO_CLOCK_FREQ_KHZ=40000
CONFIG_ESP_HOSTED_SDIO_PIN_CMD=19
CONFIG_ESP_HOSTED_SDIO_PIN_CLK=18
CONFIG_ESP_HOSTED_SDIO_PIN_D0=14
CONFIG_ESP_HOSTED_SDIO_PIN_D1=15
CONFIG_ESP_HOSTED_SDIO_PIN_D2=16
CONFIG_ESP_HOSTED_SDIO_PIN_D3=17
CONFIG_ESP_WIFI_REMOTE_ENABLED=y

# Disable SoftAP
CONFIG_ESP_WIFI_SOFTAP_SUPPORT=n

# HTTPS (for GitHub API)
CONFIG_MBEDTLS_CERTIFICATE_BUNDLE=y
CONFIG_MBEDTLS_CERTIFICATE_BUNDLE_DEFAULT_FULL=y
```
